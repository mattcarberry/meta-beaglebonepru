## conf/layer.conf
```bitbake
# We have a conf and classes directory, add to BBPATH
BBPATH .= ":${LAYERDIR}"

# We have recipes-* directories, add to BBFILES
BBFILES += "${LAYERDIR}/recipes-*/*/*.bb ${LAYERDIR}/recipes-*/*/*.bbappend"

BBFILE_COLLECTIONS += "beaglebonepru"
BBFILE_PATTERN_beaglebonepru = "^${LAYERDIR}/"
BBFILE_PRIORITY_beaglebonepru = "1"

# This should only be incremented on significant changes that will
# cause compatibility issues with other layers
LAYERVERSION_beaglebonepru = "1"

LAYERDEPENDS_beaglebonepru = "core"

LAYERSERIES_COMPAT_beaglebonepru = "warrior"
```
